## buildroot/Config.in
```kconfig
source "$BR2_EXTERNAL_FOSTROM_PATH/package/fostrom-kernel/Config.in"
source "$BR2_EXTERNAL_FOSTROM_PATH/package/fostrom-shim/Config.in"
source "$BR2_EXTERNAL_FOSTROM_PATH/package/xdelta3/Config.in"
```

## buildroot/package/fostrom-kernel/Config.in
```kconfig
config BR2_PACKAGE_FOSTROM_KERNEL
	bool "fostrom-kernel"
	help
	  The kernel, its modules, firmware and microcode, from a
	  kernel-builds release.

	  https://github.com/fostrom/kernel-builds

if BR2_PACKAGE_FOSTROM_KERNEL

config BR2_PACKAGE_FOSTROM_KERNEL_TARGET
	string "target"
	help
	  Which of the release's archives: amd64, arm64 or rpi.

endif
```

## buildroot/package/fostrom-shim/Config.in
```kconfig
config BR2_PACKAGE_FOSTROM_SHIM
	bool "fostrom-shim"
	depends on BR2_USE_MMU
	help
	  A second busybox, statically linked, installed only to be bind
	  mounted into workload containers.
```

## buildroot/package/xdelta3/Config.in
```kconfig
config BR2_PACKAGE_XDELTA3
	bool "xdelta3"
	help
	  VCDIFF (RFC 3284) delta compression, the decoder half of
	  appcode bundle deltas.
	  
	  https://github.com/jmacd/xdelta
```

## config/amd64.defconfig
```kconfig
# Buildroot options for amd64

# Architecture and toolchain
BR2_x86_64=y
BR2_TOOLCHAIN_EXTERNAL_URL="https://github.com/nerves-project/toolchains/releases/download/v15.3.0/nerves_toolchain_x86_64_nerves_linux_gnu-linux_${shell uname -m}-15.3.0-C85F8A0.tar.xz"
BR2_TOOLCHAIN_EXTERNAL_CUSTOM_PREFIX="$(ARCH)-nerves-linux-gnu"

# Boot: GRUB
BR2_TARGET_GRUB2=y
BR2_TARGET_GRUB2_X86_64_EFI=y
BR2_TARGET_GRUB2_BUILTIN_CONFIG_EFI="${NERVES_DEFCONFIG_DIR}/grub-embedded.cfg"
BR2_TARGET_GRUB2_BUILTIN_MODULES_EFI="boot linux ext2 squash4 fat part_msdos part_gpt normal efi_gop efi_uga loadenv echo true test sleep search search_fs_uuid regexp"
BR2_PACKAGE_HOST_DOSFSTOOLS=y

# Platform tools
BR2_PACKAGE_DMIDECODE=y
BR2_PACKAGE_EFIBOOTMGR=y
# BR2_PACKAGE_E2FSPROGS_FSCK is not set

# System name and kernel
BR2_NERVES_SYSTEM_NAME="fostrom_system_amd64"
BR2_PACKAGE_FOSTROM_KERNEL_TARGET="amd64"
```

## config/arm64.defconfig
```kconfig
# Buildroot options for arm64

# Architecture and toolchain
BR2_aarch64=y
BR2_TOOLCHAIN_EXTERNAL_URL="https://github.com/nerves-project/toolchains/releases/download/v15.3.0/nerves_toolchain_aarch64_nerves_linux_gnu-linux_${shell uname -m}-15.3.0-8DAF9F3.tar.xz"
BR2_TOOLCHAIN_EXTERNAL_CUSTOM_PREFIX="aarch64-nerves-linux-gnu"

# Boot: GRUB
BR2_TARGET_GRUB2=y
BR2_TARGET_GRUB2_BUILTIN_CONFIG_EFI="${NERVES_DEFCONFIG_DIR}/grub-embedded.cfg"
BR2_TARGET_GRUB2_BUILTIN_MODULES_EFI="boot linux ext2 squash4 fat part_msdos part_gpt normal efi_gop loadenv echo true test sleep search search_fs_uuid regexp"
BR2_PACKAGE_HOST_DOSFSTOOLS=y

# Platform tools
BR2_PACKAGE_DMIDECODE=y
BR2_PACKAGE_EFIBOOTMGR=y
# BR2_PACKAGE_E2FSPROGS_FSCK is not set

# System name and kernel
BR2_NERVES_SYSTEM_NAME="fostrom_system_arm64"
BR2_PACKAGE_FOSTROM_KERNEL_TARGET="arm64"
```

## config/common.defconfig
```kconfig
# Buildroot options for every target

# Toolchain
BR2_TOOLCHAIN_EXTERNAL=y
BR2_TOOLCHAIN_EXTERNAL_CUSTOM=y
BR2_TOOLCHAIN_EXTERNAL_DOWNLOAD=y
BR2_TOOLCHAIN_EXTERNAL_HEADERS_6_0=y
BR2_TOOLCHAIN_EXTERNAL_CUSTOM_GLIBC=y
# BR2_TOOLCHAIN_EXTERNAL_INET_RPC is not set
BR2_TOOLCHAIN_EXTERNAL_CXX=y
BR2_TOOLCHAIN_EXTERNAL_FORTRAN=y
BR2_TOOLCHAIN_EXTERNAL_OPENMP=y

# Downloads, patches and reproducibility
BR2_PRIMARY_SITE="https://sources.buildroot.net"
BR2_BACKUP_SITE="https://dl.nerves-project.org"
BR2_DOWNLOAD_FORCE_CHECK_HASHES=y
BR2_GLOBAL_PATCH_DIR="${BR2_EXTERNAL_NERVES_PATH}/patches ${BR2_EXTERNAL_FOSTROM_PATH}/patches"
BR2_TAR_OPTIONS="--no-same-owner"
BR2_ENABLE_DEBUG=y
BR2_REPRODUCIBLE=y

# System: init, skeleton, overlays, hooks, locale
BR2_INIT_NONE=y
BR2_ROOTFS_SKELETON_CUSTOM=y
BR2_ROOTFS_SKELETON_CUSTOM_PATH="${BR2_EXTERNAL_NERVES_PATH}/board/nerves-common/skeleton"
BR2_ROOTFS_OVERLAY="${BR2_EXTERNAL_NERVES_PATH}/board/nerves-common/rootfs_overlay ${NERVES_DEFCONFIG_DIR}/rootfs_overlay"
BR2_ROOTFS_POST_BUILD_SCRIPT="${NERVES_DEFCONFIG_DIR}/post-build.sh ${BR2_EXTERNAL_NERVES_PATH}/board/nerves-common/post-build.sh"
BR2_ROOTFS_POST_IMAGE_SCRIPT="${NERVES_DEFCONFIG_DIR}/post-createfs.sh"
BR2_ENABLE_LOCALE_WHITELIST="locale-archive"
BR2_GENERATE_LOCALE="en_US.UTF-8"
# BR2_TARGET_ROOTFS_TAR is not set

# Nerves
BR2_PACKAGE_NERVES_CONFIG=y
BR2_PACKAGE_NERVES_CONFIG_ACCEPT_RNG_NOTICE=y
BR2_PACKAGE_NBTTY=y

# Kernel, container shim, appcode deltas
BR2_PACKAGE_FOSTROM_KERNEL=y
BR2_PACKAGE_FOSTROM_SHIM=y
BR2_PACKAGE_XDELTA3=y

# Busybox
BR2_PACKAGE_BUSYBOX_CONFIG="${BR2_EXTERNAL_NERVES_PATH}/board/nerves-common/busybox.config"
BR2_PACKAGE_BUSYBOX_CONFIG_FRAGMENT_FILES="${NERVES_DEFCONFIG_DIR}/busybox.fragment"
BR2_PACKAGE_BUSYBOX_SHOW_OTHERS=y

# Containers
BR2_PACKAGE_BUBBLEWRAP=y
BR2_PACKAGE_UTIL_LINUX_BINARIES=y
BR2_PACKAGE_UTIL_LINUX_NSENTER=y
BR2_PACKAGE_UTIL_LINUX_UNSHARE=y

# Networking
BR2_PACKAGE_IPROUTE2=y
BR2_PACKAGE_ETHTOOL=y
BR2_PACKAGE_IW=y
BR2_PACKAGE_TCPDUMP=y
BR2_PACKAGE_SOCAT=y
BR2_PACKAGE_LIBMNL=y
BR2_PACKAGE_BIND=y
BR2_PACKAGE_BIND_TOOLS=y
BR2_PACKAGE_CA_CERTIFICATES=y
BR2_PACKAGE_LIBCURL=y
BR2_PACKAGE_LIBCURL_CURL=y

# Wifi
BR2_PACKAGE_WPA_SUPPLICANT=y
BR2_PACKAGE_WPA_SUPPLICANT_WIRED=y
BR2_PACKAGE_WPA_SUPPLICANT_AP_SUPPORT=y
BR2_PACKAGE_WPA_SUPPLICANT_MESH_NETWORKING=y
BR2_PACKAGE_WPA_SUPPLICANT_AUTOSCAN=y
BR2_PACKAGE_WPA_SUPPLICANT_HOTSPOT=y
BR2_PACKAGE_WPA_SUPPLICANT_DEBUG_SYSLOG=y
BR2_PACKAGE_WPA_SUPPLICANT_WPS=y
BR2_PACKAGE_WPA_SUPPLICANT_WPA3=y
BR2_PACKAGE_WPA_SUPPLICANT_CLI=y

# Storage and filesystems
BR2_PACKAGE_E2FSPROGS=y
BR2_PACKAGE_HOST_E2FSPROGS=y
BR2_PACKAGE_QUOTA=y
BR2_PACKAGE_NVME=y
BR2_PACKAGE_MMC_UTILS=y
BR2_PACKAGE_SMARTMONTOOLS=y

# Hardware and diagnostics
BR2_PACKAGE_KMOD=y
BR2_PACKAGE_KMOD_TOOLS=y
BR2_PACKAGE_PCIUTILS=y
BR2_PACKAGE_LM_SENSORS=y
BR2_PACKAGE_MEMTESTER=y
BR2_PACKAGE_STRESS_NG=y
BR2_PACKAGE_STRACE=y

# Shell tools
BR2_PACKAGE_HTOP=y
BR2_PACKAGE_NANO=y
BR2_PACKAGE_VIM=y
# BR2_PACKAGE_VIM_RUNTIME is not set
BR2_PACKAGE_TMUX=y
BR2_PACKAGE_JQ=y
BR2_PACKAGE_NCURSES_TARGET_PROGS=y
```

## config/rpi.defconfig
```kconfig
# Buildroot options for rpi

# Architecture and toolchain
BR2_aarch64=y
BR2_TOOLCHAIN_EXTERNAL_URL="https://github.com/nerves-project/toolchains/releases/download/v15.3.0/nerves_toolchain_aarch64_nerves_linux_gnu-linux_${shell uname -m}-15.3.0-8DAF9F3.tar.xz"
BR2_TOOLCHAIN_EXTERNAL_CUSTOM_PREFIX="aarch64-nerves-linux-gnu"

# Boot: Raspberry Pi firmware
BR2_PACKAGE_RPI_FIRMWARE=y
BR2_PACKAGE_RPI_FIRMWARE_CUSTOM_VERSION="1.20260521"
BR2_PACKAGE_RPI_FIRMWARE_BOOTCODE_BIN=y
BR2_PACKAGE_RPI_FIRMWARE_VARIANT_PI_X=y
BR2_PACKAGE_RPI_FIRMWARE_VARIANT_PI4_X=y
# BR2_PACKAGE_RPI_FIRMWARE_INSTALL_DTBS is not set
BR2_PACKAGE_HOST_DTC=y

# System: device table
BR2_ROOTFS_DEVICE_TABLE="${BR2_EXTERNAL_NERVES_PATH}/board/nerves-common/device_table.txt"

# Platform tools
BR2_PACKAGE_RPI_UTILS=y
BR2_PACKAGE_F2FS_TOOLS=y

# System name and kernel
BR2_NERVES_SYSTEM_NAME="fostrom_system_rpi"
BR2_PACKAGE_FOSTROM_KERNEL_TARGET="rpi"
```
